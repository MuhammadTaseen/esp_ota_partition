## sdkconfig.defaults
```kconfig
# Default sdkconfig parameters to use the OTA
# partition table layout, with a 16MB flash size
CONFIG_ESPTOOLPY_FLASHSIZE_16MB=y
CONFIG_PARTITION_TABLE_TWO_OTA=y

#
# Example Configuration
#
CONFIG_ENV_GPIO_RANGE_MIN=0
CONFIG_ENV_GPIO_RANGE_MAX=48
CONFIG_ENV_GPIO_IN_RANGE_MAX=48
CONFIG_ENV_GPIO_OUT_RANGE_MAX=48
CONFIG_EXAMPLE_FIRMWARE_UPG_URL="http://128.199.236.110:80/DEFAULT/controller/v1/ODIE2410010034851897CCD8N/softwaremodules/664/artifacts/storage.bin"
# CONFIG_EXAMPLE_SKIP_COMMON_NAME_CHECK is not set
# CONFIG_EXAMPLE_SKIP_VERSION_CHECK is not set
CONFIG_EXAMPLE_GPIO_DIAGNOSTIC=4
CONFIG_EXAMPLE_OTA_RECV_TIMEOUT=5000
# end of Example Configuration

#
# Example Connection Configuration
#
CONFIG_EXAMPLE_CONNECT_WIFI=y
# CONFIG_EXAMPLE_WIFI_SSID_PWD_FROM_STDIN is not set
CONFIG_EXAMPLE_PROVIDE_WIFI_CONSOLE_CMD=y
CONFIG_EXAMPLE_WIFI_SSID="taseen"
CONFIG_EXAMPLE_WIFI_PASSWORD="taseen@123"
CONFIG_EXAMPLE_WIFI_CONN_MAX_RETRY=6
# CONFIG_EXAMPLE_WIFI_SCAN_METHOD_FAST is not set
CONFIG_EXAMPLE_WIFI_SCAN_METHOD_ALL_CHANNEL=y
```
